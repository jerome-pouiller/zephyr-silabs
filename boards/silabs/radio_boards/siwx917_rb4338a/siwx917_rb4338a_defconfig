## boards/silabs/radio_boards/siwx917_rb4338a/siwx917_rb4338a_defconfig
```kconfig
# Copyright (c) 2023 Antmicro
# SPDX-License-Identifier: Apache-2.0

CONFIG_SYS_CLOCK_HW_CYCLES_PER_SEC=32000000
# CLOCK_TICKS is also used for UART clock
CONFIG_SYS_CLOCK_TICKS_PER_SEC=100
CONFIG_TEST_RANDOM_GENERATOR=y
CONFIG_CONSOLE=y
CONFIG_UART_CONSOLE=y
CONFIG_SERIAL=y
CONFIG_PINCTRL=y
CONFIG_NETWORKING=y
CONFIG_WIFI=y
```

## drivers/wifi/siwx917/Kconfig.siwx917
```kconfig
# Copyright (c) 2023 Antmicro
# SPDX-License-Identifier: Apache-2.0

config WIFI_SIWX917
        bool "Silabs SiWx917 SoC series WiFi driver"
	default y
	depends on DT_HAS_SILABS_SIWX917_WIFI_ENABLED
	select CMSIS_RTOS_V2
	help
	  Enable WiFi driver for the Silabs SiWx917 SoC series.
```
